/*
 * Copyright 2024 FLIR Systems.
 *
 * The code contained herein is licensed under the GNU General Public
 * License. You may obtain a copy of the GNU General Public License
 * Version 2 or later at the following locations:
 *
 * http://www.opensource.org/licenses/gpl-license.html
 * http://www.gnu.org/copyleft/gpl.html
 */

/dts-v1/;

#include "imx6qp.dtsi"
#include "imx6qp-ec701.dtsi"

/ {
	model = "Teledyne FLIR i.MX6 Dual Plus ec701 Board";
	// TODO Remove ec702 once fvdk has been updated to support ec701
	compatible = "fsl,imx6qp-ec701", "fsl,imx6qp-ec702", "fsl,imx6qp-flir", "fsl,imx6qp";
	chosen {
		bootargs = "console=ttymxc0,115200 earlyprintk";
	};
};
